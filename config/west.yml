## config/west.yml
```yaml
manifest:
  remotes:
    - name: moergo-sc # Use moergo zmk fork for full glove80 support
      url-base: https://github.com/moergo-sc
    - name: urob
      url-base: https://github.com/urob
  projects:
    - name: zmk
      remote: moergo-sc
      revision: ce69e85f585c724142aae37ddf8a7e019ff19e93 # MoErgo v26.09; track main/releases
      import: app/west.yml
    - name: zmk-helpers
      remote: urob
      revision: a98b7f7e4a5130a5150dce81bb8aa419fc3ca3c0 # track urob/zmk-helpers v2
    # Override the moving Zephyr branch imported by ZMK; retain its import filter.
    - name: zephyr
      revision: dacab4875df72109b96cc8977547a0dc04875bcd
      import:
        name-blocklist:
        - ci-tools
        - hal_altera
        - hal_cypress
        - hal_infineon
        - hal_microchip
        - hal_nxp
        - hal_openisa
        - hal_silabs
        - hal_xtensa
        - hal_st
        - hal_ti
        - loramac-node
        - mcuboot
        - mcumgr
        - net-tools
        - openthread
        - edtt
        - trusted-firmware-m
      url: https://github.com/zmkfirmware/zephyr
  self:
    path: config
```

## experimental/west.yml
```yaml
# Experimental official ZMK main snapshot, 2026-10-05; not the stable manifest.
manifest:
  projects:
  - name: zmk
    url: https://github.com/zmkfirmware/zmk
    revision: 5b51501fead672c41b5cfb396f3dafe0894bf4e9
    import: app/west.yml
  - name: zmk-helpers
    url: https://github.com/urob/zmk-helpers
    revision: a98b7f7e4a5130a5150dce81bb8aa419fc3ca3c0
  - name: zephyr
    revision: 10ba6d0cb38bc3d258775d27982f707599320085
    import:
      name-blocklist:
      - ci-tools
      - hal_altera
      - hal_cypress
      - hal_infineon
      - hal_microchip
      - hal_nxp
      - hal_openisa
      - hal_xtensa
      - hal_st
      - hal_ti
      - loramac-node
      - mcuboot
      - mcumgr
      - net-tools
      - openthread
      - edtt
      - trusted-firmware-m
    url: https://github.com/zmkfirmware/zephyr
  self:
    path: experimental
```
